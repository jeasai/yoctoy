## meta-yoctoy-app/conf/layer.conf
```bitbake
# We have a conf and classes directory, add to BBPATH
BBPATH .= ":${LAYERDIR}"

# We have recipes-* directories, add to BBFILES
BBFILES += "${LAYERDIR}/recipes-*/*/*.bb \
            ${LAYERDIR}/recipes-*/*/*.bbappend"

BBFILE_COLLECTIONS += "meta-yoctoy-app"
BBFILE_PATTERN_meta-yoctoy-app = "^${LAYERDIR}/"
BBFILE_PRIORITY_meta-yoctoy-app = "6"

LAYERDEPENDS_meta-yoctoy-app = "core"
LAYERSERIES_COMPAT_meta-yoctoy-app = "kirkstone langdale"

DISTRO_FEATURES:append = " systemd"
DISTRO_FEATURES_BACKFILL_CONSIDERED += "sysvinit"
VIRTUAL-RUNTIME_init_manager = "systemd"
VIRTUAL-RUNTIME_initscripts = "systemd-compat-units"

MACHINE = "raspberrypi3-64"
LICENSE_FLAGS_ACCEPTED = "synaptics-killswitch"
MACHINE_ESSENTIAL_EXTRA_RRECOMMENDS += "kernel-modules"
INSTALL:append= " rpi-config"
```
